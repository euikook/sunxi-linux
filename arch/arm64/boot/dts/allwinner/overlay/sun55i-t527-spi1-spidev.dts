/dts-v1/;
/plugin/;

/ {
	fragment@0 {
		target = <&spi1>;

		__overlay__ {
			status = "okay";

			spidev@0 {
				reg = <0>;
				compatible = "rohm,dh2228fv";
				spi-max-frequency = <500000>;
				spi-rx-bus-width = <0x1>;
				spi-tx-bus-width = <0x1>;
			};
		};
	};
};
