/dts-v1/;
/plugin/;


/ {
	compatible = "allwinner,sun50i-h616";

	fragment@0 {
		target = <&pwm1>;
		__overlay__ {
			pinctrl-names = "default";
			pinctrl-0 = <&pwm1_pg_pins>;
			status = "okay";
		};
	};
};
