/dts-v1/;
/plugin/;


/ {
	compatible = "allwinner,sun50i-h616";

	fragment@0 {
		target = <&pwm2>;
		__overlay__ {
			pinctrl-names = "default";
			pinctrl-0 = <&pwm2_pi_pins>;
			status = "okay";
		};
	};
};
