/dts-v1/;
/plugin/;


/ {
	compatible = "allwinner,sun50i-h616";

	fragment@0 {
		target = <&pwm4>;
		__overlay__ {
			pinctrl-names = "default";
			pinctrl-0 = <&pwm4_pi_pins>;
			status = "okay";
		};
	};
};
