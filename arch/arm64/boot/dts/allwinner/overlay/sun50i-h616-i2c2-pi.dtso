/dts-v1/;
/plugin/;


/ {
	compatible = "allwinner,sun50i-h616";

	fragment@0 {
		target-path = "/aliases";
		__overlay__ {
			i2c2 = "/soc/i2c@5002800";
		};
	};

	fragment@1 {
		target = <&i2c2>;
		__overlay__ {
			pinctrl-names = "default";
			pinctrl-0 = <&i2c2_pi_pins>;
			status = "okay";
		};
	};
};
